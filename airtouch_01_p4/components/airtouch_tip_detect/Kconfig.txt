## airtouch_01_p4/components/airtouch_tip_detect/Kconfig.txt
```kconfig
menu "models: airtouch_tip_detect"
    config AIRTOUCH_TIP_DETECT_PICO_S8_V1
        bool "airtouch_tip_detect_pico_s8_v1"
        default y

    config AIRTOUCH_TIP_DETECT_MODEL_TYPE
        int
        default 0 if AIRTOUCH_TIP_DETECT_PICO_S8_V1

    choice
        prompt "model location"
        default AIRTOUCH_TIP_DETECT_MODEL_IN_FLASH_RODATA
        help
            airtouch_tip_detect model location
        config AIRTOUCH_TIP_DETECT_MODEL_IN_FLASH_RODATA
            bool "flash_rodata"
        config AIRTOUCH_TIP_DETECT_MODEL_IN_FLASH_PARTITION
            bool "flash_partition"
        config AIRTOUCH_TIP_DETECT_MODEL_IN_SDCARD
            bool "sdcard"
    endchoice

    config AIRTOUCH_TIP_DETECT_MODEL_LOCATION
        int
        default 0 if AIRTOUCH_TIP_DETECT_MODEL_IN_FLASH_RODATA
        default 1 if AIRTOUCH_TIP_DETECT_MODEL_IN_FLASH_PARTITION
        default 2 if AIRTOUCH_TIP_DETECT_MODEL_IN_SDCARD
endmenu
```
